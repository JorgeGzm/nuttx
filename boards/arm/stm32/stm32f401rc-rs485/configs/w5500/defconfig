## boards/arm/stm32h7/linum-stm32h753bi/Kconfig
```kconfig
#
# For a description of the syntax of this configuration file,
# see the file kconfig-language.txt in the NuttX tools repository.
#

config RGB_LED_ONESHOT
    bool "Enable led oneshot"
    default n
```
